## esp32/avinox-sync/main/Kconfig.projbuild
```kconfig
menu "Avinox-Sync"
    config AVX_LED_GPIO
        int "GPIO der RGB-Status-LED (WS2812), -1 = aus"
        range -1 48
        default 48
        help
            ESP32-S3-DevKitC-1: GPIO 48 (je nach Board-Revision auch 38).

    config AVX_BOOT_GPIO
        int "GPIO der BOOT-Taste (low-aktiv)"
        range 0 48
        default 0
        help
            3 s gedrückt halten (im Betrieb): Einrichtungsmodus. 10 s: Werkseinstellung (Konfiguration löschen).

    config AVX_SYNC_INTERVAL_MIN
        int "Abstand zwischen zwei Syncs (Minuten)"
        range 1 1440
        default 10

    config AVX_NO_DRIVE_HINT_S
        int "Sekunden ohne Laufwerk bis zum Hinweis (orange blinkend)"
        range 5 3600
        default 30

    config AVX_CHUNK_SIZE
        int "Größe eines Upload-Stücks (Byte)"
        range 4096 262144
        default 32768
endmenu
```

## esp32/avinox-sync/sdkconfig.defaults
```kconfig
CONFIG_IDF_TARGET="esp32s3"
CONFIG_ESPTOOLPY_FLASHSIZE_4MB=y
CONFIG_ESP_CONSOLE_UART_DEFAULT=y
CONFIG_ESP_CONSOLE_SECONDARY_USB_SERIAL_JTAG=y
CONFIG_PARTITION_TABLE_CUSTOM=y
CONFIG_PARTITION_TABLE_CUSTOM_FILENAME="partitions.csv"
CONFIG_FATFS_LFN_HEAP=y
CONFIG_FATFS_MAX_LFN=255
CONFIG_USB_HOST_HUBS_SUPPORTED=y
# Handys schicken beim Captive-Portal-Check lange Header
CONFIG_HTTPD_MAX_REQ_HDR_LEN=1024
CONFIG_ESP_MAIN_TASK_STACK_SIZE=4096
```

## esp32/usb-probe/main/Kconfig.projbuild
```kconfig
menu "USB-Probe"
    config PROBE_LED_GPIO
        int "GPIO der RGB-Status-LED (WS2812), -1 = aus"
        range -1 48
        default 48
        help
            ESP32-S3-DevKitC-1: GPIO 48 (je nach Board-Revision auch 38).

    config PROBE_BOOT_GPIO
        int "GPIO der BOOT-Taste (low-aktiv)"
        range 0 48
        default 0
        help
            Beim Start 10 s lang gedrückt halten: Log-Modus, USB-Host wird nicht gestartet.
endmenu
```

## esp32/usb-probe/sdkconfig.defaults
```kconfig
CONFIG_IDF_TARGET="esp32s3"
CONFIG_ESP_CONSOLE_USB_SERIAL_JTAG=y
CONFIG_PARTITION_TABLE_CUSTOM=y
CONFIG_PARTITION_TABLE_CUSTOM_FILENAME="partitions.csv"
CONFIG_FATFS_LFN_HEAP=y
CONFIG_FATFS_MAX_LFN=255
CONFIG_USB_HOST_HUBS_SUPPORTED=y
```

## firmware/usb-probe/sdkconfig.defaults
```kconfig
CONFIG_IDF_TARGET="esp32s3"
CONFIG_ESP_CONSOLE_UART_DEFAULT=y
CONFIG_FATFS_LFN_HEAP=y
CONFIG_FATFS_MAX_LFN=255
CONFIG_USB_HOST_HUBS_SUPPORTED=y
```
